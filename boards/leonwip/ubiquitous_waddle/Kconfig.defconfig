## boards/leonwip/ubiquitous_waddle/Kconfig.defconfig
```kconfig
# Copyright (c) 2025 leonwip
# SPDX-License-Identifier: Apache-2.0

if BOARD_UBIQUITOUS_WADDLE

config USB_SELF_POWERED
    default n

endif # BOARD_UBIQUITOUS_WADDLE
```

## boards/leonwip/ubiquitous_waddle/Kconfig.ubiquitous_waddle
```kconfig
# Copyright (c) 2025 leonwip
# SPDX-License-Identifier: Apache-2.0

config BOARD_UBIQUITOUS_WADDLE
    select SOC_STM32G0B1XX
    select HAS_SEGGER_RTT if ZEPHYR_SEGGER_MODULE
```

## boards/leonwip/ubiquitous_waddle/board.yml
```yaml
# Copyright (c) 2025 leonwip
# SPDX-License-Identifier: Apache-2.0

board:
  name: ubiquitous_waddle
  vendor: leonwip
  socs:
    - name: stm32g0b1xx
```

## boards/leonwip/ubiquitous_waddle/ubiquitous_waddle_defconfig
```kconfig
# Copyright (c) 2025 leonwip
# SPDX-License-Identifier: Apache-2.0

CONFIG_ARM_MPU=y
CONFIG_GPIO=y
```

## west.yml
```yaml
# Copyright (c) 2025 leonwip
# SPDX-License-Identifier: Apache-2.0

manifest:
  projects:
    - name: zephyr
      url: https://github.com/leonwip/zephyr
      revision: v4.3.0+leonwip
      import:
        name-allowlist:
          - cmsis_6
          - hal_stm32
          - segger
          - mcuboot
    - name: cannectivity
      url: https://github.com/leonwip/cannectivity
      revision: v1.3.0+leonwip
```
